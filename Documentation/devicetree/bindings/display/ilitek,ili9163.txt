## Documentation/devicetree/bindings/display/ilitek,ili9163.txt
```
Ilitek ILI9163 display panels

This binding is for display panels using an Ilitek ILI9163 controller in SPI
mode.

Required properties:
- compatible:	"newhaven,1.8-128160EF", "ilitek,ili9163"
- dc-gpios:	D/C pin
- reset-gpios:	Reset pin

The node for this driver must be a child node of a SPI controller, hence
all mandatory properties described in ../spi/spi-bus.txt must be specified.

Optional properties:
- rotation:	panel rotation in degrees counter clockwise (0,90,180,270)
- backlight:	phandle of the backlight device attached to the panel

Example:
	display@0{
		compatible = "newhaven,1.8-128160EF", "ilitek,ili9163"
		reg = <0>;
		spi-max-frequency = <32000000>;
		dc-gpios = <&gpio0 9 GPIO_ACTIVE_HIGH>;
		reset-gpios = <&gpio0 8 GPIO_ACTIVE_HIGH>;
		rotation = <270>;
		backlight = <&backlight>;
	};
```

## Documentation/devicetree/bindings/display/ilitek,ili9341.txt
```
Ilitek ILI9341/ST7789S display panels

This binding is for display panels using either an Ilitek ILI9341 or a
Sitronix ST7789S controller in SPI mode.

Required properties:
- compatible:	"adafruit,yx240qv29", "ilitek,ili9341", "sitronix,st7789s"
- dc-gpios:	D/C pin
- reset-gpios:	Reset pin

The node for this driver must be a child node of a SPI controller, hence
all mandatory properties described in ../spi/spi-bus.txt must be specified.

Optional properties:
- rotation:	panel rotation in degrees counter clockwise (0,90,180,270)
- backlight:	phandle of the backlight device attached to the panel

Example:
	display@0{
		compatible = "adafruit,yx240qv29", "ilitek,ili9341";
		reg = <0>;
		spi-max-frequency = <32000000>;
		dc-gpios = <&gpio0 9 GPIO_ACTIVE_HIGH>;
		reset-gpios = <&gpio0 8 GPIO_ACTIVE_HIGH>;
		rotation = <270>;
		backlight = <&backlight>;
	};
```

## Documentation/devicetree/bindings/mfd/adi,ad242x-bus.yaml
```yaml
# SPDX-License-Identifier: (GPL-2.0 OR BSD-2-Clause)
%YAML 1.2
---
$id: "http://devicetree.org/schemas/mfd/adi,ad242x-bus.yaml#"
$schema: "http://devicetree.org/meta-schemas/core.yaml#"

title: Analog Devices AD242x A²B bus node

maintainers:
  - Daniel Mack <daniel@zonque.org>

description: |
  AD242x slave nodes represent the secondary I²C address a master node
  transceiver exposes on the bus.

properties:
  compatible:
    enum:
      - adi,ad2428w-bus

  reg:
    maxItems: 1
    description: |
      The secondary I²C address of the master node
      (called 'BUS' in the datasheet)

required:
  - compatible
  - reg
```

## sound/soc/holoplot/Kconfig
```kconfig
# SPDX-License-Identifier: GPL-2.0-only
config SND_SOC_HOLOPLOT_PCM
	tristate "Holoplot PCM"
	select SND_SOC_GENERIC_DMAENGINE_PCM
	help
	  Say Y or M if you want to add support for DMA backed PCN support for
	  Holoplot device. If in doubt, say N.
```
